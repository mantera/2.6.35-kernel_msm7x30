## drivers/i2c/chips/Kconfig
```kconfig
#
# Miscellaneous I2C chip drivers configuration
#
# *** DEPRECATED! Do not add new entries! See Makefile ***
#

menu "Miscellaneous I2C Chip support"

config SENSORS_MT9T013
	tristate "MT9T013 Camera Driver"
	depends on I2C
	default y
	help
	 MT9T013 Camera Driver implemented by HTC.

config SENSORS_YAS529
	bool "Yamaha YAS529 Driver"
	depends on MSM_CAMERA && FIH_CONFIG_GROUP
	default y
	help
		Yamaha Ecompass Driver implemented by FIH.       

config SENSORS_LTR502ALS
	bool "Liteon ALS Driver"
 	depends on I2C && FIH_CONFIG_GROUP
	default y
	help
		Liteon ALS Driver implemented by FIH. 

endmenu
```
